/*
 * Google Peach Pit board device tree source
 *
 * Copyright (c) 2013 The Chromium OS Authors. All rights reserved.
 * Use of this source code is governed by a BSD-style license that can be
 * found in the LICENSE file.
 */

/dts-v1/;
/include/ "exynos54xx.dtsi"
/include/ "exynos542x-peach.dtsi"
#ifdef CONFIG_CHROMEOS
/include/ "flashmap-exynos-ro.dtsi"
/include/ "flashmap-4mb-rw.dtsi"
/include/ "chromeos-exynos.dtsi"
#endif
/ {
	model = "Google Peach Pit";

	compatible = "google,pit-rev#", "google,pit",
		"google,peach", "samsung,exynos5420", "samsung,exynos5";
};
