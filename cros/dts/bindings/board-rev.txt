## cros/dts/bindings/board-rev.txt
```
Board Revision Bindings
=======================

The device tree node which describes the Board Revision strappings is:

Required properties:
- compatible : "google,board-revision"
- google,board-rev-gpios : List of GPIOs used for reading board revision.
  Should be listed most significant first.  These are tristate GPIOs where
  strongly pulling low is a 0, strongly pulling high is a 1, and floating
  is a 2.  Revision GPIOs will translate from ternary to binary for decoding
  the revision.

Optional properties:
- google,board-rev-map : A byte array mapping physical revision numbers to
  logical revision/subrevision numbers in the code.  Each entry in this array
  is two bytes: a revision and a subrev.  It could contain up to 3 ** n_gpios
  entries (each entry is 2 bytes).  If this is not present (or if it's too
  short) we'll assume a subrev of 0 and use the raw GPIO values.


Example
=======

	board-rev {
		compatible = "google,board-revision";
		google,board-rev-gpios = <&gpio 76 0>,
					 <&gpio 75 0>,
					 <&gpio 74 0>,
					 <&gpio 73 0>;

		/*
		 * Pit has 4 ternary bits giving us 81 possible raw revisions.
		 * We allocate the lowest two BINARY bits as a "subrevision", so
		 * we have 20 main revisions with 4 subrevisions each.
		 *
		 * If we see revision 2 we'll call that board revision "3"
		 * to match how boards have been labelled elsewhere.  Boards
		 * will increment from there.  If we see revision 0/1 we'll
		 * assume we've wrapped around.
		 */
		google,board-rev-map = [15 00  15 01  15 02  15 03
					16 00  16 01  16 02  16 03

					03 00  03 01  03 02  03 03
					04 00  04 01  04 02  04 03
					05 00  05 01  05 02  05 03
					06 00  06 01  06 02  06 03
					07 00  07 01  07 02  07 03
					08 00  08 01  08 02  08 03
					09 00  09 01  09 02  09 03
					0a 00  0a 01  0a 02  0a 03
					0b 00  0b 01  0b 02  0b 03
					0c 00  0c 01  0c 02  0c 03
					0d 00  0d 01  0d 02  0d 03
					0e 00  0e 01  0e 02  0e 03
					0f 00  0f 01  0f 02  0f 03
					10 00  10 01  10 02  10 03
					11 00  11 01  11 02  11 03
					12 00  12 01  12 02  12 03
					13 00  13 01  13 02  13 03
					14 00  14 01  14 02  14 03

					f0 00];
	};
```

## cros/dts/bindings/chromeos-ec.txt
```
Chrome EC bindings
==================

The device tree node which describes the Chrome Embedded Controller (EC)
is as follows:

Required properties :
- compatible = "google,chrome-ec"
- model : Manufacturer and part number of EC part
- flash : Contains address and size of flash memory (in standard reg property)


Optional properties within flash node :
- erase-value : Value that flash erases to, typically 0xff or 0. If -1, or
   missing, then it means that the value is not known.


Example
=======

	chrome-ec {
		compatible = "google,chrome-ec";
		model = "st,stm32f100";
		flash@8000000 {
			reg = <0x08000000 0x20000>;
			erase-value = <0xff>;
		};
	};
```

## cros/dts/bindings/flashmap.txt
```
Chrome OS Flash Map Binding
===========================

The device tree node which describes the contents of the firmware flash
memory is as follows:

Required properties :
- name = "flash" or "flash@<addr>";

(note there is no compatible string required.)


Sub-nodes describe each section of the flash. The idea is that the
sections cover the entire contents of the flash and thus describe its
entire contents. Gaps are allowed, but will generate warnings. Overlaps
are not allowed, although sections which contain nothing are ignored
and so can overlap with others.

Required properties :

 - label : Label for this section (a user readable string)

Optional properties :

 - reg : Two cells :
            - start offset of this section
            - size of this section

 - size : Size of this section (the start offset is assumed to be
      immediately after the previous section.)

(note that only one of 'reg' and 'size' should be specified.)

 - read-only : Boolean property, which if present, indicates that this
      section is in read-only flash

 - required : Indicates that this section is required for the firmware
      to boot. If it is not present then there will be a vital piece
      missing. This is used to mark the minimum sections that must be
      present. For example, where there is a RO section and two RW
      sections, only the RO section is marked required. Note that if
      the firmware is built with only 'required' sections, then it will
      only operate with non-verified boot.

 - type : If present this describes the type of this section of the
      flash. Allowable types are described below.

  - loaded-with-uboot: 1 if this section is loaded as part of U-Boot and
      therefore does not need to be loaded again from SPI flash. Loading
      again used to happen with the EC used by software sync, since it is
      tacked onto the end of the EC binary. This seemingly unimportant
      optimisation saves around 50ms on link.

  - compress: If present this property indicates that the blob is
      compressed. It is valid in blob and vblock section types. The only
      possible value is "lzo" since that is the only supported compression
      format. The data are compressed in one unit, which means that to
      get at parts of the data you will need to decompress all of it.

Section Types
-------------

Here are described the section types and the required properties for
each.

Empty :
 - no 'type' property
 - ignored by the flash image creation tool (cros_bundle_firmware)


Blob : Contains data read from a list of files
 - type = "blob <list_of_files>"

  <list_of_files> is a comma-separated list of files to put into the
    section. For example: type = "blob boot,dtb" means to put the files
    'boot' and 'dtb' into this section. These files are just a convenient
    names for files on the disk - they are set up (i.e. hard coded)
    by the firmware bundler.

 For blobs where there is more than one file, we provide a way to access
 the content, through a sub-node for each entry. That subnode should have a
 standard reg property (with offset and size). The name of the subnode is the
 same as the name of the file. Using the previous example:

   type = "blob boot,dtb";
   boot {
      reg = <0 0x12345>;
   };
   dtb {
      reg = <0x12348 0x33dc>;
   };

 Currently supported files are:
   - coreboot : A coreboot.rom file
   - bootstub : An Nvidia Tegra BCT + bootloader
   - signed : A signed bootstub (signed Nvidia Tegra BCT + bootloader)
   - exynos-bl1 : A Samsung Exynos BL1 (first stage boot loader)
   - exynos-bl2 : A Samsung Exynos BL2 (second stage boot loader)
        This has special handling - please see below.
   - boot : The U-Boot binary
   - dtb : The device tree binary
   - skeleton : The coreboot skeleton file
   - gbb : Google Binary Block, containing settings and recovery bitmaps

Fmap : Contains a 'flashrom' FMAP which is a description of the flash
    contents used by the 'flashrom' tool.
 - type = "fmap"
 - ver-major : Major version number (normally 1)
 - ver-minor : Minor version number (normally 0)

Wiped : Contains the same byte value throughout
 - type = "wiped"
 - wipe-value : Value to put in section. For example:
      wipe_value = <0> means that the section will be all zeroes
      wipe_value = <0xff> means that the section will be all 0xff

Blobstring : Contains a single string
 - type = "blobstring <name>"

  <name> is the name of the string to include. The name is just a
    convenient name for the string - the strings are set up (i.e.
    hard-coded) by the firmware packer.

  Currently supported names are:
    - fwid : Firmware ID, made from the machine model and the Chrome OS
        version (e.g. Google_Daisy.2401.0.2012_06_18_2004)

Keyblock : Contains a key block
 - type = "keyblock <list_of_files>"
 - keyblock : Filename (within key directory) of the key block to use,
        e.g. keyblock = "firmware.keyblock"
 - signprivate : Filename (within key directory) of the private key
        to use. e.g. signprivate = "firmware_data_key.vbprivk"
 - version : Version number to pass to vbutil
 - kernelkey : Filename (within key directory) of the kernel key
        to use. e.g. kernelkey = "kernel_subkey.vbpubk"
 - preamble-flags : Value for preamble flags

 <list_of_files> is as for blob.

  The files are joined together and signed with vbutil to produce a
  key block, and it is this key block which is put into the section.



Samsung Exynos BL2
------------------

This file is used to load U-Boot. Within U-Boot this is called SPL,
Secondary Program Loader. Samsung calls it BL2, boot loader 2, since
BL1 is the first think loaded by the IROM.

BL2 also contains a machine parameter block, which can be configured
from the firmware bundler. Each parameter consists of a 32-bit word with a
character tag. The currently-defined parameters are below. Note that
many of these come from the device tree, so we show the node and
property that they come from, and the value for the property where
relevant.

  Code         Name
  ====         ========
  a            ARM clock frequency in MHz (/dmc 'arm-frequency')
  b            Boot source: Where to load U-Boot from:
                  4 : emmc: MMC
                  20 : spi : Serial Flash (SPI)
                  32 : straps : Load according to the OM pins
                  33 : usb: USB download
  f            Memory frequency in MHz (/dmc 'clock-frequency')
  i            i2c base address for early access (meant for PMIC). This
                  is the physical register address of the relevant
                  i2c controller in the Exynos memory map.
  m            Memory type from /dmc property 'mem-type'
                  0 : ddr2
                  1 : ddr3
                  2 : lpddr2
                  3 : lpddr3
  M            Memory Manufacturer name from /dmc property 'mem-manuf'
                  0 : autodetect : Auto-detect if possible
                  1 : elpida : Elpida memory
                  2 : samsung : Samsung memory
  r            board rev GPIO numbers used to read board revision
                       (lower halfword=first gpio, upper=second gpio)
  s            Serial base address (physical register address of UART
                  in Exynos memory map)
  u            U-Boot size
                  Size of data to be loaded by SPL
                   (calculated by the bundle tool)
  v            Memory interleave size from /dmc property
               'mem-interleave-size' (normally 31)

See smdk5250_spl.c and spl.h in the U-Boot source for the C structure.
```

## doc/uImage.FIT/kernel.its
```
/*
 * Simple U-boot uImage source file containing a single kernel
 */

/dts-v1/;

/ {
	description = "Simple image with single Linux kernel";
	#address-cells = <1>;

	images {
		kernel@1 {
			description = "Vanilla Linux kernel";
			data = /incbin/("./vmlinux.bin.gz");
			type = "kernel";
			arch = "ppc";
			os = "linux";
			compression = "gzip";
			load = <00000000>;
			entry = <00000000>;
			hash@1 {
				algo = "crc32";
			};
			hash@2 {
				algo = "sha1";
			};
		};
	};

	configurations {
		default = "config@1";
		config@1 {
			description = "Boot Linux kernel";
			kernel = "kernel@1";
		};
	};
};



For x86 a setup node is also required:

/dts-v1/;

/ {
	description = "Simple image with single Linux kernel on x86";
	#address-cells = <1>;

	images {
		kernel@1 {
			description = "Vanilla Linux kernel";
			data = /incbin/("./Image");
			type = "kernel";
			arch = "x86";
			os = "linux";
			compression = "lzo";
			load = <00000000>;
			entry = <00000000>;
			hash@2 {
				algo = "sha1";
			};
		};

		setup@1 {
			description = "Linux setup.bin";
			data = /incbin/("./setup.bin");
			type = "setup";
			arch = "x86";
			os = "linux";
			compression = "none";
			load = <00100000>;
			entry = <00100000>;
			hash@2 {
				algo = "sha1";
			};
		};
	};

	configurations {
		default = "config@1";
		config@1 {
			description = "Boot Linux kernel";
			kernel = "kernel@1";
			setup = "setup@1";
		};
	};
};
```
