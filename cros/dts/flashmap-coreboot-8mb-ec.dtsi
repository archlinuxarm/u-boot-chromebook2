/*
 * Copyright (c) 2012 The Chromium OS Authors. All rights reserved.
 * Use of this source code is governed by a BSD-style license that can be
 * found in the LICENSE file.
 */

/ {
	/* Add our EC binary into RW binaries */
	flash@ff800000 {
		rw-a-ec {
			type = "blob ecrw";
			add-hash;
		};
		rw-b-ec {
			type = "blob ecrw";
			add-hash;
		};
	};
};
