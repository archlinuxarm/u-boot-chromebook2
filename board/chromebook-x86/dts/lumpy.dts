/dts-v1/;

/include/ "coreboot.dtsi"
/include/ "chromeos-coreboot.dtsi"
/include/ "flashmap-coreboot-8mb_1mb_rom.dtsi"

/ {
	model = "Google Lumpy";
	compatible = "google,lumpy", "intel,celeron-sandybridge";

	config {
		hwid = "X86 LUMPY TEST 6638";
		hda_codec_beep = <1>;
	};

	chromeos-config {
		oprom-matters;
		vboot-flag-ec-in-rw {
			compatible = "google,const-flag";
			value = <0>;
		};
	};
};
